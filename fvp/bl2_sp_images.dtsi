/* SPDX-License-Identifier: BSD-3-Clause */
/*
 * Copyright (c) 2021, Arm Limited. All rights reserved.
 */

internal_trusted_storage {
	uuid = <0xdc1eef48 0xb17a4ccf 0xac8bdfcf 0xf7711b14>;
	load-address = <0x7000000>;
};

crypto_sp {
	uuid = <0xd9df52d5 0x16a24bb2 0x9aa4d26d 0x3b84e8c0>;
	load-address = <0x7100000>;
};

protected_storage_sp {
	uuid = <0x751bf801 0x3dde4768 0xa5140f10 0xaeed1790>;
	load-address = <0x7200000>;
};

initial_attestation_sp {
	uuid = "a1baf155-8876-4695-8f7c-54955e8db974";
	load-address = <0x7300000>;
};
